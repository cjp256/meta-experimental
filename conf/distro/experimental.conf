## conf/distro/experimental.conf
```bitbake
USERDISTRO := "${DISTRO}"
DISTRO = "experimental"
DISTRO_NAME = "experimental"
BUILDNAME = "experimental"
ROOT_FLASH_SIZE ??= "32"
IMAGE_LINGUAS ?= '${@base_less_or_equal("ROOT_FLASH_SIZE", "16", "", "en-us", d)}'

PREFERRED_PROVIDER_dbus-glib                     = "dbus-glib"
PREFERRED_PROVIDER-gconf-dbus                    = "gconf"
PREFERRED_PROVIDER_hotplug                       = "systemd"
PREFERRED_PROVIDER_opkg                          ?= "opkg"
PREFERRED_PROVIDER_opkg-native                   ?= "opkg-native"

# Prefer systemd-boot over grub
EFI_PROVIDER                                     = "systemd-boot"

VIRTUAL-RUNTIME_init_manager = "systemd"

# Uncomment to completely disable support for sysv scripts:
#PACKAGECONFIG_pn-systemd = "xz"

# Enable systemd support in kernels
KERNEL_ENABLE_CGROUPS = "1"

# USE-flag like features
DISTRO_FEATURES += "tk"
DISTRO_FEATURES += "x11"
DISTRO_FEATURES += "3g"
DISTRO_FEATURES += "pulseaudio"

# OpenGL support
DISTRO_FEATURES += "opengl"

# Enable wayland
DISTRO_FEATURES += "wayland"

# Enable virtualization
DISTRO_FEATURES += "virtualization"

# Enable systemd support
DISTRO_FEATURES += "systemd"

# Enable xen support
DISTRO_FEATURES += "xen"

# Inherit the default LIBC features superset from OE-core
DISTRO_FEATURES += "${DISTRO_FEATURES_LIBC}"
```
